## tests/fixtures/tree/arch/arm/Kconfig
```kconfig
config ARM
	def_bool y
	select HAVE_SMP

config HAVE_PCI
	bool

config HAVE_SMP
	bool
```

## tests/fixtures/tree/arch/x86/Kconfig
```kconfig
config X86
	def_bool y
	select HAVE_PCI
	select HAVE_SMP

config HAVE_PCI
	bool

config HAVE_SMP
	bool
```
